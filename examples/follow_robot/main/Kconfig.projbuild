## examples/follow_robot/main/Kconfig.projbuild
```kconfig
menu "Follow-me suitcase (follow + obstacle avoidance)"

comment "--- Drive motors (rear differential drive, TB6612/DRV8833 style) ---"

config FOLLOW_ROBOT_MOTOR_LEFT_PWM_GPIO
    int "Left motor PWM (PWMA) GPIO"
    default 4
    help
        PWM/speed pin of the rear-LEFT motor channel.
        NOTE: assign all six motor pins to GPIOs that are actually FREE on your
        board. On the ATK-DNESP32S3 most pins are taken by LCD/camera/I2S/SPI;
        a motor-driver expansion board or a dedicated control MCU is expected.

config FOLLOW_ROBOT_MOTOR_LEFT_IN1_GPIO
    int "Left motor direction IN1 (AIN1) GPIO"
    default 5

config FOLLOW_ROBOT_MOTOR_LEFT_IN2_GPIO
    int "Left motor direction IN2 (AIN2) GPIO"
    default 6

config FOLLOW_ROBOT_MOTOR_LEFT_INVERT
    bool "Invert left motor direction"
    default n

config FOLLOW_ROBOT_MOTOR_RIGHT_PWM_GPIO
    int "Right motor PWM (PWMB) GPIO"
    default 7

config FOLLOW_ROBOT_MOTOR_RIGHT_IN1_GPIO
    int "Right motor direction IN1 (BIN1) GPIO"
    default 15

config FOLLOW_ROBOT_MOTOR_RIGHT_IN2_GPIO
    int "Right motor direction IN2 (BIN2) GPIO"
    default 16

config FOLLOW_ROBOT_MOTOR_RIGHT_INVERT
    bool "Invert right motor direction"
    default n

config FOLLOW_ROBOT_PWM_FREQ_HZ
    int "Motor PWM frequency (Hz)"
    default 20000

config FOLLOW_ROBOT_MIN_DUTY_PCT
    int "Motor dead-zone duty (%) - smallest duty that makes the wheel turn"
    default 12

config FOLLOW_ROBOT_MAX_DUTY_PCT
    int "Motor max duty (%) - top speed / current limit"
    default 90

config FOLLOW_ROBOT_TRACK_WIDTH_MM
    int "Track width: distance between the two rear wheels (mm)"
    default 300

config FOLLOW_ROBOT_MAX_WHEEL_SPEED_MMPS
    int "Wheel linear speed at full duty (mm/s) - open-loop calibration"
    default 800

comment "--- Follow behaviour ---"

config FOLLOW_ROBOT_FOLLOW_DISTANCE_MM
    int "Desired standoff distance behind the user (mm)"
    default 1000

config FOLLOW_ROBOT_STOP_BAND_MM
    int "Stop band below standoff where the robot holds still (mm)"
    default 250

config FOLLOW_ROBOT_MAX_LINEAR_MMPS
    int "Max follow linear speed (mm/s)"
    default 700

config FOLLOW_ROBOT_MAX_ANGULAR_MRADPS
    int "Max yaw rate (milli-rad/s)"
    default 1600

comment "--- Obstacle avoidance ---"

config FOLLOW_ROBOT_EMERGENCY_DIST_MM
    int "Emergency-stop distance, front cone / ultrasonic (mm)"
    default 350

config FOLLOW_ROBOT_SLOW_DIST_MM
    int "Start slowing down below this front clearance (mm)"
    default 1200

config FOLLOW_ROBOT_SAFE_DIST_MM
    int "A lidar sector closer than this counts as blocked (mm)"
    default 600

config FOLLOW_ROBOT_ROBOT_HALF_WIDTH_MM
    int "Half of the chassis width, used to widen blocked sectors (mm)"
    default 220

config FOLLOW_ROBOT_LIDAR_FORWARD_DEG
    int "Lidar raw angle that points to robot FORWARD (deg)"
    default 0
    help
        The RPLIDAR reports angles relative to its own zero mark. Set this to
        the raw lidar angle that aligns with the robot's forward (+x) axis.

config FOLLOW_ROBOT_LIDAR_CW
    bool "Lidar angle increases clockwise (RPLIDAR default)"
    default y
    help
        RPLIDAR C1 measures angle clockwise looking down. Enable so the driver
        flips it into the robot's counter-clockwise-positive convention.

comment "--- UWB tag -> follow target mapping ---"

config FOLLOW_ROBOT_UWB_LEFT_IS_POS_X
    bool "UWB Xcm positive means user is to the LEFT"
    default n
    help
        The BU0x TWR frame reports Xcm (lateral) and Ycm (forward). If your kit
        maps +Xcm to the user's RIGHT, leave this disabled; enable it if +Xcm is
        to the LEFT. Used to build the follow bearing.

comment "--- Sensor wiring (mirrors the sensor_hub example defaults) ---"

config FOLLOW_ROBOT_UWB_UART
    int "BU UWB UART port"
    default 1
config FOLLOW_ROBOT_UWB_RX_GPIO
    int "BU UWB ESP RX GPIO"
    default 18
config FOLLOW_ROBOT_UWB_TX_GPIO
    int "BU UWB ESP TX GPIO"
    default 8
config FOLLOW_ROBOT_UWB_BAUD
    int "BU UWB baudrate"
    default 115200

config FOLLOW_ROBOT_LIDAR_UART
    int "RPLIDAR UART port"
    default 2
config FOLLOW_ROBOT_LIDAR_RX_GPIO
    int "RPLIDAR ESP RX GPIO"
    default 17
config FOLLOW_ROBOT_LIDAR_TX_GPIO
    int "RPLIDAR ESP TX GPIO"
    default 9
config FOLLOW_ROBOT_LIDAR_BAUD
    int "RPLIDAR baudrate"
    default 460800

# Both ultrasonics use the per-instance software (bit-bang) UART: the two
# hardware UARTs are taken by UWB and the lidar. A02YYUW is 9600 baud, RX-only.
config FOLLOW_ROBOT_ULTRA_LEFT_RX_GPIO
    int "Front-left ultrasonic (A02YYUW) RX GPIO (SW UART)"
    default 35
config FOLLOW_ROBOT_ULTRA_RIGHT_RX_GPIO
    int "Front-right ultrasonic (A02YYUW) RX GPIO (SW UART)"
    default 36

config FOLLOW_ROBOT_IMU_ENABLE
    bool "Read IMU yaw for telemetry / heading hold"
    default y
config FOLLOW_ROBOT_I2C_SDA_GPIO
    int "IMU I2C SDA GPIO"
    default 11
    depends on FOLLOW_ROBOT_IMU_ENABLE
config FOLLOW_ROBOT_I2C_SCL_GPIO
    int "IMU I2C SCL GPIO"
    default 12
    depends on FOLLOW_ROBOT_IMU_ENABLE
config FOLLOW_ROBOT_IMU_ADDR
    hex "IMU 7-bit I2C address"
    default 0x23
    depends on FOLLOW_ROBOT_IMU_ENABLE

config FOLLOW_ROBOT_CONTROL_HZ
    int "Control loop frequency (Hz)"
    default 50

endmenu
```

## examples/sensor_hub/main/Kconfig.projbuild
```kconfig
menu "Autobox sensor hub test"

config SENSOR_HUB_A02YYUW_ENABLE
    bool "Enable A02YYUW ultrasonic #1 test"
    default y

config SENSOR_HUB_A02YYUW_USE_SW_UART
    bool "Use software (GPIO bit-bang) UART for A02YYUW #1"
    default y
    depends on SENSOR_HUB_A02YYUW_ENABLE
    help
        All sensors must run simultaneously so A02YYUW #1 now defaults to SW
        UART, freeing hardware UART1 for BU UWB. The IO35 pin is unchanged.

config SENSOR_HUB_A02YYUW_UART
    int "A02YYUW #1 hardware UART port"
    default 1
    depends on SENSOR_HUB_A02YYUW_ENABLE

config SENSOR_HUB_A02YYUW_RX_GPIO
    int "A02YYUW #1 ESP32 RX GPIO"
    default 35
    depends on SENSOR_HUB_A02YYUW_ENABLE

config SENSOR_HUB_A02YYUW_TX_GPIO
    int "A02YYUW #1 ESP32 TX GPIO (-1 = unused)"
    default -1
    depends on SENSOR_HUB_A02YYUW_ENABLE

config SENSOR_HUB_A02YYUW_BAUDRATE
    int "A02YYUW #1 UART baudrate"
    default 9600
    depends on SENSOR_HUB_A02YYUW_ENABLE

config SENSOR_HUB_A02YYUW2_ENABLE
    bool "Enable A02YYUW ultrasonic #2 test"
    default y

config SENSOR_HUB_A02YYUW2_USE_SW_UART
    bool "Use software (GPIO bit-bang) UART for A02YYUW #2"
    default y
    depends on SENSOR_HUB_A02YYUW2_ENABLE

config SENSOR_HUB_A02YYUW2_UART
    int "A02YYUW #2 hardware UART port"
    default 2
    depends on SENSOR_HUB_A02YYUW2_ENABLE

config SENSOR_HUB_A02YYUW2_RX_GPIO
    int "A02YYUW #2 ESP32 RX GPIO"
    default 36
    depends on SENSOR_HUB_A02YYUW2_ENABLE

config SENSOR_HUB_A02YYUW2_TX_GPIO
    int "A02YYUW #2 ESP32 TX GPIO (-1 = unused)"
    default -1
    depends on SENSOR_HUB_A02YYUW2_ENABLE

config SENSOR_HUB_A02YYUW2_BAUDRATE
    int "A02YYUW #2 UART baudrate"
    default 9600
    depends on SENSOR_HUB_A02YYUW2_ENABLE

config SENSOR_HUB_BU_UWB_ENABLE
    bool "Enable BU03/BU04 passive UART monitor test"
    default y

config SENSOR_HUB_BU_UWB_UART
    int "BU03/BU04 UART port"
    default 1
    depends on SENSOR_HUB_BU_UWB_ENABLE

config SENSOR_HUB_BU_UWB_RX_GPIO
    int "BU03/BU04 ESP32 RX GPIO"
    default 6
    depends on SENSOR_HUB_BU_UWB_ENABLE

config SENSOR_HUB_BU_UWB_TX_GPIO
    int "BU03/BU04 ESP32 TX GPIO"
    default 7
    depends on SENSOR_HUB_BU_UWB_ENABLE

config SENSOR_HUB_BU_UWB_BAUDRATE
    int "BU03/BU04 UART baudrate"
    default 115200
    depends on SENSOR_HUB_BU_UWB_ENABLE

config SENSOR_HUB_FSR_ENABLE
    bool "Enable FSR pressure ADC test"
    default y

config SENSOR_HUB_FSR_ADC_GPIO
    int "FSR ADC GPIO, used for logs and wiring docs"
    default 8
    depends on SENSOR_HUB_FSR_ENABLE

config SENSOR_HUB_FSR_ADC_CHANNEL
    int "FSR ADC1 channel"
    default 7
    depends on SENSOR_HUB_FSR_ENABLE

config SENSOR_HUB_I2C_SDA_GPIO
    int "Shared I2C SDA GPIO"
    default 11
    depends on SENSOR_HUB_IMU_ENABLE || SENSOR_HUB_VL53L1X_ENABLE

config SENSOR_HUB_I2C_SCL_GPIO
    int "Shared I2C SCL GPIO"
    default 12
    depends on SENSOR_HUB_IMU_ENABLE || SENSOR_HUB_VL53L1X_ENABLE

config SENSOR_HUB_I2C_SPEED_HZ
    int "Shared I2C clock speed"
    default 400000
    depends on SENSOR_HUB_IMU_ENABLE || SENSOR_HUB_VL53L1X_ENABLE

config SENSOR_HUB_IMU_ADDR
    hex "IMU 7-bit I2C address"
    default 0x23
    depends on SENSOR_HUB_IMU_ENABLE

config SENSOR_HUB_RPLIDAR_ENABLE
    bool "Enable RPLIDAR C1 test"
    default y

config SENSOR_HUB_RPLIDAR_UART
    int "RPLIDAR C1 UART port"
    default 2
    depends on SENSOR_HUB_RPLIDAR_ENABLE

config SENSOR_HUB_RPLIDAR_RX_GPIO
    int "RPLIDAR C1 ESP32 RX GPIO"
    default 17
    depends on SENSOR_HUB_RPLIDAR_ENABLE

config SENSOR_HUB_RPLIDAR_TX_GPIO
    int "RPLIDAR C1 ESP32 TX GPIO"
    default 18
    depends on SENSOR_HUB_RPLIDAR_ENABLE

config SENSOR_HUB_RPLIDAR_BAUDRATE
    int "RPLIDAR C1 UART baudrate"
    default 460800
    depends on SENSOR_HUB_RPLIDAR_ENABLE

config SENSOR_HUB_IMU_ENABLE
    bool "Enable custom I2C IMU test"
    default y

config SENSOR_HUB_VL53L1X_ENABLE
    bool "Enable VL53L1X ToF test"
    default y

config SENSOR_HUB_VL53L1X_ADDR_8BIT
    hex "VL53L1X 8-bit I2C address"
    default 0x52
    depends on SENSOR_HUB_VL53L1X_ENABLE

config SENSOR_HUB_VL53L1X_TIMING_BUDGET_MS
    int "VL53L1X timing budget in ms"
    default 50
    depends on SENSOR_HUB_VL53L1X_ENABLE

config SENSOR_HUB_VL53L1X_INTER_MEASUREMENT_MS
    int "VL53L1X inter-measurement period in ms"
    default 55
    depends on SENSOR_HUB_VL53L1X_ENABLE

endmenu
```

## examples/sensor_hub/sdkconfig.defaults
```kconfig
CONFIG_IDF_TARGET="esp32s3"

# Ultrasonic #1: software (bit-bang) UART on IO35 (same pin, mode changed HW→SW to free UART1).
CONFIG_SENSOR_HUB_A02YYUW_ENABLE=y
CONFIG_SENSOR_HUB_A02YYUW_USE_SW_UART=y
CONFIG_SENSOR_HUB_A02YYUW_UART=1
CONFIG_SENSOR_HUB_A02YYUW_RX_GPIO=35
CONFIG_SENSOR_HUB_A02YYUW_TX_GPIO=-1
CONFIG_SENSOR_HUB_A02YYUW_BAUDRATE=9600

# Ultrasonic #2: software (bit-bang) UART on IO36 (unchanged).
CONFIG_SENSOR_HUB_A02YYUW2_ENABLE=y
CONFIG_SENSOR_HUB_A02YYUW2_USE_SW_UART=y
CONFIG_SENSOR_HUB_A02YYUW2_UART=2
CONFIG_SENSOR_HUB_A02YYUW2_RX_GPIO=36
CONFIG_SENSOR_HUB_A02YYUW2_TX_GPIO=-1
CONFIG_SENSOR_HUB_A02YYUW2_BAUDRATE=9600

# BU UWB: HW UART1 on GPIO6/7.
CONFIG_SENSOR_HUB_BU_UWB_ENABLE=y
CONFIG_SENSOR_HUB_BU_UWB_UART=1
CONFIG_SENSOR_HUB_BU_UWB_RX_GPIO=6
CONFIG_SENSOR_HUB_BU_UWB_TX_GPIO=7
CONFIG_SENSOR_HUB_BU_UWB_BAUDRATE=115200

# FSR: ADC1 on GPIO8.
CONFIG_SENSOR_HUB_FSR_ENABLE=y
CONFIG_SENSOR_HUB_FSR_ADC_GPIO=8
CONFIG_SENSOR_HUB_FSR_ADC_CHANNEL=7

# RPLIDAR C1: HW UART2 on GPIO17/18.
CONFIG_SENSOR_HUB_RPLIDAR_ENABLE=y
CONFIG_SENSOR_HUB_RPLIDAR_UART=2
CONFIG_SENSOR_HUB_RPLIDAR_RX_GPIO=17
CONFIG_SENSOR_HUB_RPLIDAR_TX_GPIO=18
CONFIG_SENSOR_HUB_RPLIDAR_BAUDRATE=460800

# IMU: shared I2C0 on GPIO11/12, addr 0x23.
CONFIG_SENSOR_HUB_IMU_ENABLE=y
CONFIG_SENSOR_HUB_IMU_ADDR=0x23

# VL53L1X: shared I2C0 on GPIO11/12, addr 0x52.
CONFIG_SENSOR_HUB_VL53L1X_ENABLE=y
CONFIG_SENSOR_HUB_VL53L1X_ADDR_8BIT=0x52
CONFIG_SENSOR_HUB_VL53L1X_TIMING_BUDGET_MS=50
CONFIG_SENSOR_HUB_VL53L1X_INTER_MEASUREMENT_MS=55

# Shared I2C pins.
CONFIG_SENSOR_HUB_I2C_SDA_GPIO=11
CONFIG_SENSOR_HUB_I2C_SCL_GPIO=12
CONFIG_SENSOR_HUB_I2C_SPEED_HZ=400000
```
