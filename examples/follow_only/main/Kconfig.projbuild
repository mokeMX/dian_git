## examples/follow_only/main/Kconfig.projbuild
```kconfig
menu "Follow-only suitcase (pure following, no obstacle avoidance)"

comment "--- Drive motors (rear diff-drive: APO-DL ESC + RC PWM) ---"

config FOLLOW_ONLY_LEFT_ESC_GPIO
    int "Left ESC signal GPIO (RC PWM out)"
    default 4
    help
        RC servo-pulse output to the rear-LEFT ESC (50 Hz, 1000-2000 us).

config FOLLOW_ONLY_RIGHT_ESC_GPIO
    int "Right ESC signal GPIO (RC PWM out)"
    default 5

config FOLLOW_ONLY_ESC_MIN_US
    int "ESC pulse: full reverse (us)"
    default 1000

config FOLLOW_ONLY_ESC_MID_US
    int "ESC pulse: neutral / stop (us)"
    default 1500

config FOLLOW_ONLY_ESC_MAX_US
    int "ESC pulse: full forward (us)"
    default 2000

config FOLLOW_ONLY_ESC_ARM_MS
    int "Hold neutral this long at boot so the ESC arms (ms)"
    default 2000

comment "--- AB encoders (closed-loop speed feedback) ---"
comment "WARNING: GPIO6/7/15/16 are shared with LCD B7/B6/B5/B4 on DNESP32S3."
comment "Encoder wiring must go to the motor encoder pins, NOT the LCD header."

config FOLLOW_ONLY_LEFT_ENC_A_GPIO
    int "Left encoder A GPIO"
    default 6

config FOLLOW_ONLY_LEFT_ENC_B_GPIO
    int "Left encoder B GPIO"
    default 7

config FOLLOW_ONLY_RIGHT_ENC_A_GPIO
    int "Right encoder A GPIO"
    default 15

config FOLLOW_ONLY_RIGHT_ENC_B_GPIO
    int "Right encoder B GPIO"
    default 16

config FOLLOW_ONLY_TICKS_PER_METER
    int "Encoder ticks (4x) per metre of wheel travel - CALIBRATE"
    default 2000
    help
        4x quadrature counts for one metre of forward travel. Measure: push the
        robot exactly 1 m and read the printed tick delta.

comment "--- Wheel-speed PID (us output per m/s error) ---"

config FOLLOW_ONLY_SPEED_KP
    int "Speed loop KP (us per m/s)"
    default 200

config FOLLOW_ONLY_SPEED_KI
    int "Speed loop KI (us per m/s per s)"
    default 300

config FOLLOW_ONLY_SPEED_KD
    int "Speed loop KD (us per m/s/s)"
    default 5

config FOLLOW_ONLY_SPEED_PID_LIMIT_US
    int "Max PID contribution per wheel (us)"
    default 400

config FOLLOW_ONLY_TRACK_WIDTH_MM
    int "Track width: distance between the two rear wheels (mm)"
    default 300

config FOLLOW_ONLY_MAX_WHEEL_SPEED_MMPS
    int "Top wheel speed (mm/s): sets feed-forward gain and clamps set-points"
    default 800

comment "--- Follow behaviour ---"

config FOLLOW_ONLY_FOLLOW_DISTANCE_MM
    int "Desired standoff distance behind the user (mm)"
    default 1000

config FOLLOW_ONLY_STOP_BAND_MM
    int "Stop band below standoff where the robot holds still (mm)"
    default 250

config FOLLOW_ONLY_MAX_LINEAR_MMPS
    int "Max follow linear speed (mm/s)"
    default 700

config FOLLOW_ONLY_MAX_ANGULAR_MRADPS
    int "Max yaw rate (milli-rad/s)"
    default 1600

config FOLLOW_ONLY_KP_DIST
    int "Follow Kp: range error -> linear velocity (milli, m/s per m)"
    default 900
    help
        Linear velocity = Kp_dist * (range - standoff). Higher = more aggressive
        catching up. Milli-scale for integer menuconfig entry.

config FOLLOW_ONLY_KP_BEAR
    int "Follow Kp: bearing error -> yaw rate (milli, rad/s per rad)"
    default 1600
    help
        Angular velocity = Kp_bear * bearing_to_user.

config FOLLOW_ONLY_SEARCH_ANGULAR_MRADPS
    int "Search rotation speed (milli-rad/s)"
    default 800

config FOLLOW_ONLY_SEARCH_TIMEOUT_S
    int "Search timeout before going IDLE (seconds)"
    default 6

config FOLLOW_ONLY_TARGET_FRESH_MS
    int "UWB data freshness threshold (ms)"
    default 700
    help
        Data older than this is treated as missing, triggering SEARCH/IDLE.

comment "--- IMU heading closed-loop ---"

config FOLLOW_ONLY_HEADING_KP_MILLI
    int "Heading-hold KP (milli, rad/s per rad of error)"
    default 1500
    help
        The IMU heading loop trims the angular velocity command by
        KP * (yaw_ref - yaw_measured) to suppress drift and caster scrub.

config FOLLOW_ONLY_I2C_SDA_GPIO
    int "IMU I2C SDA GPIO"
    default 39

config FOLLOW_ONLY_I2C_SCL_GPIO
    int "IMU I2C SCL GPIO"
    default 38

config FOLLOW_ONLY_IMU_ADDR
    hex "IMU 7-bit I2C address"
    default 0x23

comment "--- UWB sensor ---"

config FOLLOW_ONLY_UWB_UART
    int "BU UWB UART port"
    default 1

config FOLLOW_ONLY_UWB_RX_GPIO
    int "BU UWB ESP RX GPIO"
    default 18

config FOLLOW_ONLY_UWB_TX_GPIO
    int "BU UWB ESP TX GPIO"
    default 37

config FOLLOW_ONLY_UWB_BAUD
    int "BU UWB baudrate"
    default 115200

comment "--- SD card test-data logging ---"

config FOLLOW_ONLY_SDLOG_ENABLE
    bool "Write follow logs to SD card"
    default y
    help
        Mount the board MicroSD/TF slot with SDSPI and mirror the periodic
        follow log into /sdcard/test-data for later export.

choice FOLLOW_ONLY_SDLOG_SPI_HOST
    prompt "SD SDSPI host"
    depends on FOLLOW_ONLY_SDLOG_ENABLE
    default FOLLOW_ONLY_SDLOG_SPI_HOST_SPI2
    help
        SPI2 is shared with the onboard TF card slot on DNESP32S3.
        SPI3 is free if you need SPI2 for another device (e.g. SPILCD).

config FOLLOW_ONLY_SDLOG_SPI_HOST_SPI2
    bool "SPI2 (onboard TF slot, GPIO2/11/12/13)"
    depends on FOLLOW_ONLY_SDLOG_ENABLE

config FOLLOW_ONLY_SDLOG_SPI_HOST_SPI3
    bool "SPI3 (external / custom wiring)"
    depends on FOLLOW_ONLY_SDLOG_ENABLE
endchoice

config FOLLOW_ONLY_SDLOG_CS_GPIO
    int "SD card CS GPIO"
    depends on FOLLOW_ONLY_SDLOG_ENABLE
    default 2

config FOLLOW_ONLY_SDLOG_MOSI_GPIO
    int "SD card MOSI GPIO"
    depends on FOLLOW_ONLY_SDLOG_ENABLE
    default 11

config FOLLOW_ONLY_SDLOG_MISO_GPIO
    int "SD card MISO GPIO"
    depends on FOLLOW_ONLY_SDLOG_ENABLE
    default 13

config FOLLOW_ONLY_SDLOG_SCLK_GPIO
    int "SD card SCLK GPIO"
    depends on FOLLOW_ONLY_SDLOG_ENABLE
    default 12

config FOLLOW_ONLY_SDLOG_MAX_FILES
    int "Mounted SD max open files"
    depends on FOLLOW_ONLY_SDLOG_ENABLE
    default 4

config FOLLOW_ONLY_SDLOG_QUEUE_LEN
    int "Log queue depth (samples buffered before SD write)"
    depends on FOLLOW_ONLY_SDLOG_ENABLE
    default 32
    help
        Controls how many log samples can queue up while the SD card is busy.
        Larger = fewer drops but more RAM. 32 is enough for ~6 s at 5 Hz.

config FOLLOW_ONLY_SDLOG_FLUSH_EVERY_N
    int "Flush SD card every N samples"
    depends on FOLLOW_ONLY_SDLOG_ENABLE
    default 2
    help
        How often to call fflush(). Higher = better throughput, lower = less
        risk of losing data on power cut. 2 means flush once per 0.4s at 5 Hz.

config FOLLOW_ONLY_SDLOG_DROP_WARN_INTERVAL
    int "Warn on drop every N dropped samples"
    depends on FOLLOW_ONLY_SDLOG_ENABLE
    default 50
    help
        Throttle the "samples dropped" warning so it doesn't flood the log.
        Set to 1 to warn on every single drop.

config FOLLOW_ONLY_CONTROL_HZ
    int "Control loop frequency (Hz)"
    default 50

endmenu
```

## examples/follow_only3/main/Kconfig.projbuild
```kconfig
menu "Follow-only3: Advanced pure following (Kalman + Adaptive PID + S-Curve)"

comment "--- Drive motors (rear diff-drive: APO-DL ESC + RC PWM) ---"

config FOLLOW3_LEFT_ESC_GPIO
    int "Left ESC signal GPIO (RC PWM out)"
    default 4
    help
        RC servo-pulse output to the rear-LEFT ESC (50 Hz, 1000-2000 us).

config FOLLOW3_RIGHT_ESC_GPIO
    int "Right ESC signal GPIO (RC PWM out)"
    default 5

config FOLLOW3_ESC_MIN_US
    int "ESC pulse: full reverse (us)"
    default 1000

config FOLLOW3_ESC_MID_US
    int "ESC pulse: neutral / stop (us)"
    default 1500

config FOLLOW3_ESC_MAX_US
    int "ESC pulse: full forward (us)"
    default 2000

config FOLLOW3_ESC_ARM_MS
    int "Hold neutral this long at boot so the ESC arms (ms)"
    default 2000

comment "--- AB encoders (closed-loop speed feedback) ---"

config FOLLOW3_LEFT_ENC_A_GPIO
    int "Left encoder A GPIO"
    default 6

config FOLLOW3_LEFT_ENC_B_GPIO
    int "Left encoder B GPIO"
    default 7

config FOLLOW3_RIGHT_ENC_A_GPIO
    int "Right encoder A GPIO"
    default 15

config FOLLOW3_RIGHT_ENC_B_GPIO
    int "Right encoder B GPIO"
    default 16

config FOLLOW3_TICKS_PER_METER
    int "Encoder ticks (4x) per metre of wheel travel - CALIBRATE"
    default 2000
    help
        4x quadrature counts for one metre of forward travel.

comment "--- Wheel-speed PID ---"

config FOLLOW3_SPEED_KP
    int "Speed loop KP (us per m/s)"
    default 200

config FOLLOW3_SPEED_KI
    int "Speed loop KI (us per m/s per s)"
    default 300

config FOLLOW3_SPEED_KD
    int "Speed loop KD (us per m/s/s)"
    default 5

config FOLLOW3_SPEED_PID_LIMIT_US
    int "Max PID contribution per wheel (us)"
    default 400

config FOLLOW3_TRACK_WIDTH_MM
    int "Track width: distance between the two rear wheels (mm)"
    default 300

config FOLLOW3_MAX_WHEEL_SPEED_MMPS
    int "Top wheel speed (mm/s)"
    default 800

comment "--- Follow behaviour ---"

config FOLLOW3_FOLLOW_DISTANCE_MM
    int "Desired standoff distance behind the user (mm)"
    default 1000
    help
        Base follow distance. Dynamically adjusted by target speed.

config FOLLOW3_STOP_BAND_MM
    int "Stop band below standoff where the robot holds still (mm)"
    default 250

config FOLLOW3_MAX_LINEAR_MMPS
    int "Max follow linear speed (mm/s)"
    default 700

config FOLLOW3_MAX_ANGULAR_MRADPS
    int "Max yaw rate (milli-rad/s)"
    default 1600

config FOLLOW3_KP_DIST
    int "Follow Kp: range error -> linear velocity (milli)"
    default 900
    help
        Base proportional gain for distance control. Adaptive scaling
        increases gain when error is large.

config FOLLOW3_KP_BEAR
    int "Follow Kp: bearing error -> yaw rate (milli)"
    default 1600
    help
        Base proportional gain for bearing control. Adaptive scaling
        increases gain at low speeds for sharper turns.

config FOLLOW3_SEARCH_ANGULAR_MRADPS
    int "Search rotation speed (milli-rad/s)"
    default 800

config FOLLOW3_SEARCH_TIMEOUT_S
    int "Search timeout before going IDLE (seconds)"
    default 6

config FOLLOW3_TARGET_FRESH_MS
    int "UWB data freshness threshold (ms)"
    default 700

comment "--- Kalman Filter (noise reduction + velocity estimation) ---"

config FOLLOW3_KF_DIST_Q
    int "Kalman: distance process noise Q (x0.0001 m^2)"
    default 300
    help
        Larger Q trusts the prediction less, making filter faster to
        respond but less smooth. Typical: 100-500.

config FOLLOW3_KF_DIST_R
    int "Kalman: distance measurement noise R (x0.0001 m^2)"
    default 1600
    help
        Larger R trusts the UWB less, making filter smoother but
        slower to respond. Typical: 400-2500 (20cm = 0.04 m^2).

config FOLLOW3_KF_BEAR_Q
    int "Kalman: bearing process noise Q (x0.0001 rad^2)"
    default 200
    help
        Larger Q makes filter faster to respond to bearing changes.

config FOLLOW3_KF_BEAR_R
    int "Kalman: bearing measurement noise R (x0.0001 rad^2)"
    default 800
    help
        Larger R makes bearing estimates smoother.

comment "--- S-Curve velocity profiling (jerk limiting) ---"

config FOLLOW3_MAX_JERK
    int "Max linear jerk (x0.001 m/s^3)"
    default 1500
    help
        Rate of change of acceleration. Lower = smoother but less responsive.
        Typical: 500-2000.

config FOLLOW3_MAX_ACCEL
    int "Max linear acceleration (x0.001 m/s^2)"
    default 800
    help
        Max acceleration limit. Same as before but as part of S-curve.

config FOLLOW3_MAX_ANG_ACCEL
    int "Max angular acceleration (x0.001 rad/s^2)"
    default 6000

comment "--- Complementary filter (IMU gyro + encoder fusion) ---"

config FOLLOW3_CF_ALPHA
    int "Complementary filter alpha (x0.001)"
    default 980
    help
        Weight for gyroscope vs encoder. 980 = 98% gyro + 2% encoder.
        Gyro has good short-term response but drifts; encoder has no
        drift but slower. Typical: 950-990.

comment "--- Dynamic follow distance ---"

config FOLLOW3_DYN_DIST_FACTOR
    int "Dynamic distance speed factor (x0.001)"
    default 500
    help
        Extra distance (m) per m/s of target speed. Default 500 = 0.5s
        of extra distance per m/s (so at 1m/s target, add 0.5m).

comment "--- IMU heading closed-loop ---"

config FOLLOW3_HEADING_KP_MILLI
    int "Heading-hold KP (milli, rad/s per rad of error)"
    default 1500
    help
        The IMU heading loop uses complementary-filtered yaw for
        improved stability.

config FOLLOW3_I2C_SDA_GPIO
    int "IMU I2C SDA GPIO"
    default 39

config FOLLOW3_I2C_SCL_GPIO
    int "IMU I2C SCL GPIO"
    default 38

config FOLLOW3_IMU_ADDR
    hex "IMU 7-bit I2C address"
    default 0x23

comment "--- UWB sensor ---"

config FOLLOW3_UWB_UART
    int "BU UWB UART port"
    default 1

config FOLLOW3_UWB_RX_GPIO
    int "BU UWB ESP RX GPIO"
    default 18

config FOLLOW3_UWB_TX_GPIO
    int "BU UWB ESP TX GPIO"
    default 37

config FOLLOW3_UWB_BAUD
    int "BU UWB baudrate"
    default 115200

config FOLLOW3_CONTROL_HZ
    int "Control loop frequency (Hz)"
    default 50

endmenu
```

## examples/sensor_check/sdkconfig.defaults
```kconfig
CONFIG_IDF_TARGET="esp32s3"
CONFIG_ESP_MAIN_TASK_STACK_SIZE=8192
CONFIG_NEWLIB_NANO_FORMAT=n
```
